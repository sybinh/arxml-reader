AUTOSAR XML (schema 4-2-2)
package /TestEcucConfig
  module config TestModule
    TestContainer
      ecuc numerical param value ParamWithSysCondition: value=42, variation-point=sw-syscond=COMVEH_SECURED_OBD_GETRIEBE_01_SC==2
      ecuc textual param value ParamWithPostBuildCondition: value=TestValue, variation-point=post-build-variant-condition={matching-criterion=BuildConfig, value=Debug}
