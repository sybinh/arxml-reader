AUTOSAR XML (schema 4-2-2)
package /ComponentTypes
  application sw component type MyApplication
    provide port Port1: provided-interface=MyInterface
package /Interfaces
  sender receiver interface MyInterface
    data Element1: type=uint8
